## config/west.yml
```yaml
manifest:
  remotes:
    - name: BionicRiddle
      url-base: https://github.com/BionicRiddle
    # Additional modules containing boards/shields/custom code can be listed here as well
    # See https://docs.zephyrproject.org/3.2.0/develop/west/manifest.html#projects
    - name: dhruvinsh
      url-base: https://github.com/dhruvinsh
  projects:
    - name: zmk
      remote: BionicRiddle
      revision: main
      import: app/west.yml
    - name: zmk-tri-state
  self:
    path: config
```
